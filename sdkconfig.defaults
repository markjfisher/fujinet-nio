## sdkconfig.defaults
```kconfig
###########################################################################
# C++ (important!)
###########################################################################
CONFIG_COMPILER_CXX_EXCEPTIONS=y
CONFIG_COMPILER_CXX_RTTI=y

###########################################################################
# Filesystem
###########################################################################
CONFIG_FS_LITTLEFS=y
#CONFIG_LITTLEFS_MOUNT_PATH="/littlefs"
CONFIG_ESP32_ENABLE_COREDUMP_TO_NONE=y

###########################################################################
# Logging
###########################################################################
CONFIG_LOG_DEFAULT_LEVEL_INFO=y
CONFIG_LOG_DEFAULT_LEVEL=3

CONFIG_BOOTLOADER_LOG_LEVEL_NONE=y
CONFIG_BOOTLOADER_LOG_LEVEL=0
#CONFIG_LOG_BOOTLOADER_LEVEL_NONE=y
#CONFIG_LOG_BOOTLOADER_LEVEL_ERROR=n
#CONFIG_LOG_BOOTLOADER_LEVEL_INFO=n
#CONFIG_LOG_BOOTLOADER_LEVEL_WARN=n

# APPTRACE
CONFIG_APPTRACE_DEST_NONE=y
CONFIG_APPTRACE_DEST_UART_NONE=y
CONFIG_APPTRACE_UART_TASK_PRIO=1
CONFIG_APPTRACE_LOCK_ENABLE=y

###########################################################################
# WiFi
###########################################################################
CONFIG_ESP_WIFI_ENABLED=y

###########################################################################
# TinyUSB
###########################################################################
CONFIG_TINYUSB_CDC_ENABLED=y
CONFIG_TINYUSB_CDC_COUNT=1

# These two implicitly tell IDF we’re a CDC-only device:
CONFIG_TINYUSB_HID_COUNT=0
CONFIG_TINYUSB_MIDI_COUNT=0
CONFIG_TINYUSB_NET_MODE_NONE=y
CONFIG_TINYUSB_VENDOR_COUNT=0

CONFIG_TINYUSB_DFU_MODE_NONE=y
CONFIG_TINYUSB_MODE_DMA=y
CONFIG_TINYUSB_DEBUG_LEVEL=0

###########################################################################
# SPI RAM config
###########################################################################
CONFIG_SPIRAM=y
CONFIG_SPIRAM_MODE_OCT=y
CONFIG_SPIRAM_TYPE_AUTO=y
CONFIG_SPIRAM_CLK_IO=30
CONFIG_SPIRAM_CS_IO=26
CONFIG_SPIRAM_SPEED_80M=y
CONFIG_SPIRAM_BOOT_INIT=y
CONFIG_ESP32S3_SPIRAM_SUPPORT=y
CONFIG_SPIRAM_MEMTEST=n

###########################################################################
## Some optimizations from FN to review
###########################################################################
#CONFIG_FREERTOS_HZ=1000
#CONFIG_RTC_CLK_SRC_INT_RC=y
#CONFIG_RTC_CLK_CAL_CYCLES=0
#CONFIG_ESPTOOLPY_FLASHFREQ_80M=y
#CONFIG_ESPTOOLPY_FLASHMODE_QIO=y
#CONFIG_COMPILER_OPTIMIZATION_PERF=y
#CONFIG_BOOTLOADER_COMPILER_OPTIMIZATION_PERF=y


# -----------------------------------------------------------------------------
# TESTING AND NOTES BELOW HERE - DO NOT ENABLE ANY OF THESE, COPY THEM TO ABOVE
# -----------------------------------------------------------------------------

# SPIRAM ALL ENTRIES from FN
#CONFIG_SOC_SPIRAM_SUPPORTED=y
#CONFIG_SOC_SPIRAM_XIP_SUPPORTED=y
#CONFIG_BT_ALLOCATION_FROM_SPIRAM_FIRST=y
#CONFIG_SPIRAM=y
#CONFIG_SPIRAM_MODE_OCT=y
#CONFIG_SPIRAM_TYPE_AUTO=y
#CONFIG_SPIRAM_CLK_IO=30
#CONFIG_SPIRAM_CS_IO=26
#CONFIG_SPIRAM_SPEED_80M=y
#CONFIG_SPIRAM_SPEED=80
#CONFIG_SPIRAM_BOOT_INIT=y
#CONFIG_SPIRAM_USE_MALLOC=y
#CONFIG_SPIRAM_MALLOC_ALWAYSINTERNAL=32768
#CONFIG_SPIRAM_TRY_ALLOCATE_WIFI_LWIP=y
#CONFIG_SPIRAM_MALLOC_RESERVE_INTERNAL=32768
#CONFIG_SPIRAM_ALLOW_BSS_SEG_EXTERNAL_MEMORY=y
#CONFIG_STDATOMIC_S32C1I_SPIRAM_WORKAROUND=y
#CONFIG_ESP32S3_SPIRAM_SUPPORT=y

## Some optimizations from FN to review
#CONFIG_FREERTOS_HZ=1000
#CONFIG_BOOTLOADER_LOG_LEVEL_NONE=y
#CONFIG_BOOTLOADER_LOG_LEVEL=0
#CONFIG_RTC_CLK_SRC_INT_RC=y
#CONFIG_RTC_CLK_CAL_CYCLES=0
#CONFIG_ESPTOOLPY_FLASHFREQ_80M=y
#CONFIG_ESPTOOLPY_FLASHMODE_QIO=y
#CONFIG_COMPILER_OPTIMIZATION_PERF=y

# FULL TINYUSB config from enabling via menuconfig
#CONFIG_TINYUSB_CDC_COUNT=1
#CONFIG_TINYUSB_CDC_ENABLED=y
#CONFIG_TINYUSB_CDC_EP_BUFSIZE=512
#CONFIG_TINYUSB_CDC_RX_BUFSIZE=512
#CONFIG_TINYUSB_CDC_TX_BUFSIZE=512
#CONFIG_TINYUSB_DEBUG_LEVEL=1
#CONFIG_TINYUSB_DESC_BCD_DEVICE=0x0100
#CONFIG_TINYUSB_DESC_CDC_STRING="Espressif CDC Device"
#CONFIG_TINYUSB_DESC_MANUFACTURER_STRING="Espressif Systems"
#CONFIG_TINYUSB_DESC_PRODUCT_STRING="Espressif Device"
#CONFIG_TINYUSB_DESC_SERIAL_STRING="123456"
#CONFIG_TINYUSB_DESC_USE_DEFAULT_PID=y
#CONFIG_TINYUSB_DESC_USE_ESPRESSIF_VID=y
#CONFIG_TINYUSB_DFU_MODE_NONE=y
#CONFIG_TINYUSB_HID_COUNT=0
#CONFIG_TINYUSB_MIDI_COUNT=0
#CONFIG_TINYUSB_MODE_DMA=y
#CONFIG_TINYUSB_NET_MODE_NONE=y
#CONFIG_TINYUSB_VENDOR_COUNT=0
```

## src/Kconfig
```kconfig
menu "FujiNet-NIO"

    config FN_CONSOLE_ENABLE
        bool "Enable diagnostic console"
        default y
        help
            Enables the interactive diagnostic console task/loop in the ESP32 app.

    choice FN_CONSOLE_TRANSPORT
        prompt "Diagnostic console transport"
        default FN_CONSOLE_TRANSPORT_UART0
        depends on FN_CONSOLE_ENABLE
        help
            Select which transport is used for the diagnostic console.

            Notes:
            - UART0 works on all ESP32 variants.
            - USB OTG CDC (TinyUSB) requires TinyUSB CDC to be enabled and
              provides a separate /dev/ttyACM* on the host.
            - If FujiBus is also using USB OTG CDC, you must not share the same
              CDC ACM port for console and FujiBus.

        config FN_CONSOLE_TRANSPORT_UART0
            bool "UART0"

        config FN_CONSOLE_TRANSPORT_USB_CDC
            bool "USB OTG CDC (TinyUSB CDC ACM)"
            depends on TINYUSB_CDC_ENABLED
            help
                Uses TinyUSB CDC ACM for console.

                For a dedicated console port alongside a FujiBus CDC port,
                set CONFIG_TINYUSB_CDC_COUNT=2 and choose a different ACM port.

    endchoice

    config FN_FUJIBUS_USB_CDC_PORT
        int "FujiBus USB CDC ACM port index"
        range 0 1
        default 0
        depends on TINYUSB_CDC_ENABLED
        help
            Select which TinyUSB CDC ACM port is used by FujiBus (UsbCdcChannel).
            Valid values depend on CONFIG_TINYUSB_CDC_COUNT (0..count-1).

    config FN_CONSOLE_USB_CDC_PORT
        int "Console USB CDC ACM port index"
        range 0 1
        default 1
        depends on FN_CONSOLE_TRANSPORT_USB_CDC
        help
            Select which TinyUSB CDC ACM port is used by the diagnostic console.
            Valid values depend on CONFIG_TINYUSB_CDC_COUNT (0..count-1).

    config FN_CONSOLE_ALLOW_UART_FALLBACK
        bool "Allow UART0 fallback when USB CDC console unavailable"
        default y
        depends on FN_CONSOLE_TRANSPORT_USB_CDC
        help
            When enabled, if the console is configured for USB CDC but the CDC
            transport cannot be created (TinyUSB disabled, too few CDC ports, or
            port conflict with FujiBus), the console will fall back to UART0.
            When disabled, the console will be disabled instead of pulling in
            UART0 console support.

endmenu
```
